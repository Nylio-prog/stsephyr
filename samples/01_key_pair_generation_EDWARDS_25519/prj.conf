## CMakeLists.txt
```
# Copyright (c) 2026 STMicroelectronics
# SPDX-License-Identifier: Apache-2.0

cmake_minimum_required(VERSION 3.20.0)
find_package(Zephyr REQUIRED HINTS $ENV{ZEPHYR_BASE})
project(stsephyr_key_pair_edwards_25519)

target_sources(app PRIVATE src/main.c)
include(${CMAKE_CURRENT_SOURCE_DIR}/../common/common.cmake)
```

## sample.yaml
```
sample:
  name: STSAFE-A120 Edwards 25519 key-pair generation
  description: Generate an Ed25519 key pair, sign a message, and verify the signature

common:
  tags: [security, i2c, stsafe, ecc]
  platform_allow: [nucleo_l452re]
  integration_platforms: [nucleo_l452re]
  build_only: true
  extra_args: [SHIELD=x_nucleo_ese01a1]

tests:
  sample.stsephyr.key_pair_generation_edwards_25519: {}
```

## prj.conf
```kconfig
CONFIG_LOG=y
CONFIG_LOG_DEFAULT_LEVEL=3
CONFIG_STSEPHYR_LOG_LEVEL_INF=y
CONFIG_SERIAL=y
CONFIG_CONSOLE=y
CONFIG_MAIN_STACK_SIZE=8192
CONFIG_ASSERT=y
CONFIG_STSEPHYR_ECC_EDWARD25519=y
```

## src/main.c
```c
/*
 * Copyright (c) 2026 STMicroelectronics
 * SPDX-License-Identifier: Apache-2.0
 */

#include "stsephyr_sample.h"

#include <zephyr/sys/printk.h>

#define KEY_SLOT 1U
#define USAGE_LIMIT 255U
#define KEY_TYPE STSE_ECC_KT_ED25519
#define EXAMPLE_NAME "01_key_pair_generation_EDWARDS_25519"

#define HASH_SIZE(size) ((size) - ((size) % 16U))

int main(void)
{
	stse_Handler_t *handler;
	stse_ReturnCode_t status;
	uint8_t verification_status = 0U;
	const uint16_t message_size = HASH_SIZE(stse_ecc_info_table[KEY_TYPE].min_signature_message_size);
	uint8_t public_key[stse_ecc_info_table[KEY_TYPE].public_key_size];
	uint8_t message[message_size];
	uint8_t signature[stse_ecc_info_table[KEY_TYPE].signature_size];

	printk("STSEphyr: STSAFE-A120 Edwards 25519 key-pair generation\n");
	if (stsephyr_sample_open(&handler) != 0) {
		return 0;
	}

	status = stse_generate_ecc_key_pair(handler, KEY_SLOT, KEY_TYPE, USAGE_LIMIT, public_key);
	if (stsephyr_sample_status("generate Ed25519 key pair in slot 1", status) != 0) {
		goto out;
	}
	stsephyr_sample_hex("Public key", public_key, sizeof(public_key));

	/* Ed25519 uses the message directly (eddsa_variant = 0), not a digest. */
	stsephyr_sample_random(message, sizeof(message));
	status = stse_ecc_generate_signature(handler, KEY_SLOT, KEY_TYPE, message,
					     sizeof(message), signature);
	if (stsephyr_sample_status("sign message with Ed25519 private key", status) != 0) {
		goto out;
	}
	stsephyr_sample_hex("Signature", signature, sizeof(signature));

	status = stse_ecc_verify_signature(handler, KEY_TYPE, public_key, signature,
					   message, sizeof(message), 0U, &verification_status);
	if (stsephyr_sample_status("verify Ed25519 signature in STSAFE-A120", status) != 0 ||
	    verification_status != 1U) {
		printk("FAIL: Ed25519 signature verification was invalid\n");
		goto out;
	}

	stsephyr_sample_close();
	stsephyr_sample_pass(EXAMPLE_NAME);
	return 0;

out:
	stsephyr_sample_close();
	return 0;
}
```
