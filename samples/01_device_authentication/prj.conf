## CMakeLists.txt
```
# Copyright (c) 2026 STMicroelectronics
# SPDX-License-Identifier: Apache-2.0

cmake_minimum_required(VERSION 3.20.0)
find_package(Zephyr REQUIRED HINTS $ENV{ZEPHYR_BASE})
project(stsephyr_device_authentication)

target_sources(app PRIVATE src/main.c src/st_root_ca.c)
include(${CMAKE_CURRENT_SOURCE_DIR}/../common/common.cmake)
```

## Kconfig
```
# Copyright (c) 2026 STMicroelectronics
# SPDX-License-Identifier: Apache-2.0

mainmenu "STSAFE-A120 device authentication sample"

config SAMPLE_STSAFE_ALLOW_SIGNATURE
	bool "Sign a challenge with private-key slot 0"
	help
	  Each signature decrements the slot 0 usage limit and the global
	  private-key usage limit, unless they are set to unlimited (0xFFFF) by
	  the device personalization. The slot limit cannot be read back, so this
	  step is opt-in.

source "Kconfig.zephyr"
```

## sample.yaml
```
sample:
  name: STSAFE-A120 device authentication
  description: Verify the device certificate chain and, optionally, slot 0 key possession

common:
  tags: [security, i2c, stsafe]
  platform_allow: [nucleo_l452re]
  integration_platforms: [nucleo_l452re]
  extra_args: [SHIELD=x_nucleo_ese01a1]

tests:
  sample.stsephyr.device_authentication:
    harness: console
    harness_config:
      type: one_line
      regex: ["DONE: certificate chain verified"]
      fixture: stsafe_a120
  sample.stsephyr.device_authentication.signature:
    build_only: true
    extra_configs:
      - CONFIG_SAMPLE_STSAFE_ALLOW_SIGNATURE=y
```

## prj.conf
```kconfig
CONFIG_LOG=y
CONFIG_LOG_MODE_IMMEDIATE=y
CONFIG_MAIN_STACK_SIZE=8192

# Certificate verification on the MCU is the slowest step; use the P-256 driver.
CONFIG_MBEDTLS_PSA_P256M_DRIVER_ENABLED=y
CONFIG_SPEED_OPTIMIZATIONS=y
```

## src/main.c
```c
/*
 * Copyright (c) 2026 STMicroelectronics
 * SPDX-License-Identifier: Apache-2.0
 *
 * Authenticates the STSAFE-A120 the way a remote verifier would:
 *  1. read the device certificate from data zone 0,
 *  2. verify it against the ST production root CA,
 *  3. (opt-in) have the device sign a random challenge with private-key slot 0
 *     and verify the signature with the certificate's public key.
 *
 * stse_device_authenticate() performs the same three steps in a single call.
 */

#include "sample_common.h"

#include <certificate/stse_certificate_prints.h>

#include <zephyr/random/random.h>
#include <zephyr/sys/printk.h>

#define CERTIFICATE_ZONE     0U
#define PRIVATE_KEY_SLOT     0U
#define MAX_CERTIFICATE_SIZE 1024U
#define MAX_CHALLENGE_SIZE   66U
#define MAX_SIGNATURE_SIZE   132U

extern const uint8_t st_root_ca[];

static int prove_key_possession(stse_Handler_t *handler, stse_certificate_t *device_certificate)
{
	uint8_t challenge[MAX_CHALLENGE_SIZE];
	uint8_t signature[MAX_SIGNATURE_SIZE];
	stse_ecc_key_type_t key_type = stse_certificate_get_key_type(device_certificate);
	uint16_t challenge_size;
	uint16_t half;

	if (key_type >= STSE_ECC_KT_INVALID) {
		printk("FAIL: unsupported certificate key type\n");
		return -1;
	}
	challenge_size = stse_ecc_info_table[key_type].min_signature_message_size;
	half = stse_ecc_info_table[key_type].signature_size / 2U;
	if (challenge_size > sizeof(challenge) || 2U * half > sizeof(signature)) {
		printk("FAIL: certificate key is larger than the sample buffers\n");
		return -1;
	}

	if (sys_csrand_get(challenge, challenge_size) != 0) {
		printk("FAIL: host random generator\n");
		return -1;
	}
	sample_print_hex("Host challenge", challenge, challenge_size);

	if (sample_check("Sign challenge with slot 0",
			 stse_ecc_generate_signature(handler, PRIVATE_KEY_SLOT, key_type, challenge,
						     challenge_size, signature)) != 0) {
		return -1;
	}
	sample_print_hex("Signature (r || s)", signature, 2U * half);

	return sample_check("Verify signature with the certificate public key",
			    stse_certificate_verify_signature(device_certificate, challenge,
							      challenge_size, signature, half,
							      &signature[half], half));
}

int main(void)
{
	uint8_t certificate[MAX_CERTIFICATE_SIZE];
	stse_certificate_t root;
	stse_certificate_t device_certificate;
	stse_Handler_t *handler;
	uint16_t certificate_size;

	printk("STSAFE-A120 device authentication\n");
	if (sample_open(&handler) != 0) {
		return 0;
	}

	if (sample_check("Read certificate size",
			 stse_get_device_certificate_size(handler, CERTIFICATE_ZONE,
							  &certificate_size)) != 0) {
		goto out;
	}
	if (certificate_size > sizeof(certificate)) {
		printk("FAIL: certificate is %u bytes, buffer is %u\n", certificate_size,
		       (unsigned int)sizeof(certificate));
		goto out;
	}
	if (sample_check("Read device certificate",
			 stse_get_device_certificate(handler, CERTIFICATE_ZONE, certificate_size,
						     certificate)) != 0 ||
	    sample_check("Parse device certificate",
			 stse_certificate_parse(certificate, &device_certificate, NULL)) != 0) {
		goto out;
	}
	stse_certificate_print_parsed_cert(&device_certificate);
	printk("\n");

	if (sample_check("Parse root CA", stse_certificate_parse(st_root_ca, &root, NULL)) != 0 ||
	    sample_check("Verify device certificate against the ST root CA",
			 stse_certificate_is_parent(&root, &device_certificate, NULL)) != 0) {
		goto out;
	}

	if (!IS_ENABLED(CONFIG_SAMPLE_STSAFE_ALLOW_SIGNATURE)) {
		printk("Proof of key possession skipped (CONFIG_SAMPLE_STSAFE_ALLOW_SIGNATURE)\n");
		printk("DONE: certificate chain verified\n");
		goto out;
	}

	if (prove_key_possession(handler, &device_certificate) == 0) {
		printk("PASS: 01_device_authentication\n");
	}

out:
	sample_close();
	return 0;
}
```

## src/st_root_ca.c
```c
/*
 * Copyright (c) 2026 STMicroelectronics
 * SPDX-License-Identifier: Apache-2.0
 *
 * ST STSAFE-A production root CA certificate (DER), as used by the STSAFE-A SDK
 * examples. It must have issued the device certificate stored in data zone 0.
 */

#include <stddef.h>
#include <stdint.h>

const uint8_t st_root_ca[] = {
	0x30, 0x82, 0x01, 0xa0, 0x30, 0x82, 0x01, 0x46, 0xa0, 0x03, 0x02, 0x01, 0x02, 0x02, 0x01,
	0x01, 0x30, 0x0a, 0x06, 0x08, 0x2a, 0x86, 0x48, 0xce, 0x3d, 0x04, 0x03, 0x02, 0x30, 0x4f,
	0x31, 0x0b, 0x30, 0x09, 0x06, 0x03, 0x55, 0x04, 0x06, 0x13, 0x02, 0x4e, 0x4c, 0x31, 0x1e,
	0x30, 0x1c, 0x06, 0x03, 0x55, 0x04, 0x0a, 0x0c, 0x15, 0x53, 0x54, 0x4d, 0x69, 0x63, 0x72,
	0x6f, 0x65, 0x6c, 0x65, 0x63, 0x74, 0x72, 0x6f, 0x6e, 0x69, 0x63, 0x73, 0x20, 0x6e, 0x76,
	0x31, 0x20, 0x30, 0x1e, 0x06, 0x03, 0x55, 0x04, 0x03, 0x0c, 0x17, 0x53, 0x54, 0x4d, 0x20,
	0x53, 0x54, 0x53, 0x41, 0x46, 0x45, 0x2d, 0x41, 0x20, 0x50, 0x52, 0x4f, 0x44, 0x20, 0x43,
	0x41, 0x20, 0x30, 0x31, 0x30, 0x1e, 0x17, 0x0d, 0x31, 0x38, 0x30, 0x37, 0x32, 0x37, 0x30,
	0x30, 0x30, 0x30, 0x30, 0x30, 0x5a, 0x17, 0x0d, 0x34, 0x38, 0x30, 0x37, 0x32, 0x37, 0x30,
	0x30, 0x30, 0x30, 0x30, 0x30, 0x5a, 0x30, 0x4f, 0x31, 0x0b, 0x30, 0x09, 0x06, 0x03, 0x55,
	0x04, 0x06, 0x13, 0x02, 0x4e, 0x4c, 0x31, 0x1e, 0x30, 0x1c, 0x06, 0x03, 0x55, 0x04, 0x0a,
	0x0c, 0x15, 0x53, 0x54, 0x4d, 0x69, 0x63, 0x72, 0x6f, 0x65, 0x6c, 0x65, 0x63, 0x74, 0x72,
	0x6f, 0x6e, 0x69, 0x63, 0x73, 0x20, 0x6e, 0x76, 0x31, 0x20, 0x30, 0x1e, 0x06, 0x03, 0x55,
	0x04, 0x03, 0x0c, 0x17, 0x53, 0x54, 0x4d, 0x20, 0x53, 0x54, 0x53, 0x41, 0x46, 0x45, 0x2d,
	0x41, 0x20, 0x50, 0x52, 0x4f, 0x44, 0x20, 0x43, 0x41, 0x20, 0x30, 0x31, 0x30, 0x59, 0x30,
	0x13, 0x06, 0x07, 0x2a, 0x86, 0x48, 0xce, 0x3d, 0x02, 0x01, 0x06, 0x08, 0x2a, 0x86, 0x48,
	0xce, 0x3d, 0x03, 0x01, 0x07, 0x03, 0x42, 0x00, 0x04, 0x82, 0x19, 0x4f, 0x26, 0xcc, 0xa3,
	0x6e, 0x0e, 0x82, 0x19, 0x5c, 0xe6, 0x66, 0x58, 0xec, 0x64, 0xa4, 0x66, 0x92, 0x2f, 0x58,
	0xc9, 0xe6, 0x4b, 0x5d, 0xe1, 0xa2, 0x9e, 0x7f, 0x39, 0x86, 0x3d, 0x04, 0x26, 0x92, 0xe4,
	0xc8, 0xac, 0x79, 0xf9, 0x6d, 0x2f, 0xed, 0x52, 0x77, 0x4d, 0x52, 0x81, 0x95, 0x39, 0xf2,
	0x1f, 0x3e, 0xcd, 0x19, 0x38, 0xf8, 0x3d, 0x70, 0xae, 0xe0, 0x9c, 0xcd, 0x8d, 0xa3, 0x13,
	0x30, 0x11, 0x30, 0x0f, 0x06, 0x03, 0x55, 0x1d, 0x13, 0x01, 0x01, 0xff, 0x04, 0x05, 0x30,
	0x03, 0x01, 0x01, 0xff, 0x30, 0x0a, 0x06, 0x08, 0x2a, 0x86, 0x48, 0xce, 0x3d, 0x04, 0x03,
	0x02, 0x03, 0x48, 0x00, 0x30, 0x45, 0x02, 0x20, 0x6e, 0xe5, 0x43, 0x32, 0x47, 0xac, 0x72,
	0x34, 0xfc, 0x9d, 0x17, 0x5a, 0xa5, 0x1e, 0x83, 0x27, 0x69, 0x01, 0xad, 0xec, 0x1f, 0x00,
	0x5e, 0x37, 0x1f, 0x40, 0x73, 0x4d, 0xe3, 0x8c, 0xc5, 0x2e, 0x02, 0x21, 0x00, 0xb1, 0xd9,
	0x51, 0x6a, 0xad, 0x9a, 0x3e, 0x86, 0xd2, 0x2b, 0x8e, 0x3b, 0x3b, 0xd0, 0x14, 0x6f, 0xab,
	0xb9, 0xb9, 0x22, 0xf0, 0x45, 0x26, 0x34, 0xfe, 0x92, 0x7f, 0xf5, 0xd6, 0x36, 0xcd, 0x90,
};

const size_t st_root_ca_size = sizeof(st_root_ca);
```
