## CMakeLists.txt
```
# Copyright (c) 2026 STMicroelectronics
# SPDX-License-Identifier: Apache-2.0

cmake_minimum_required(VERSION 3.20.0)
find_package(Zephyr REQUIRED HINTS $ENV{ZEPHYR_BASE})
project(stsephyr_host_key_provisioning)

target_sources(app PRIVATE src/main.c)
include(${CMAKE_CURRENT_SOURCE_DIR}/../common/common.cmake)
```

## Kconfig
```
mainmenu "STSAFE-A120 host-key provisioning example"

config SAMPLE_STSAFE_ALLOW_HOST_KEY_PROVISIONING
	bool "Allow persistent host-key provisioning"
	default n
	help
	  DANGEROUS: writes the host MAC and cipher keys used to authenticate and
	  encrypt host sessions. Incorrect keys can make protected commands
	  unusable. The example never changes provisioning control fields.

config SAMPLE_STSAFE_HOST_MAC_KEY_HEX
	string "AES-128 host MAC key as exactly 32 hexadecimal characters"
	default ""

config SAMPLE_STSAFE_HOST_CIPHER_KEY_HEX
	string "AES-128 host cipher key as exactly 32 hexadecimal characters"
	default ""

choice SAMPLE_STSAFE_HOST_KEY_METHOD
	prompt "Host-key provisioning method"
	default SAMPLE_STSAFE_HOST_KEY_PLAINTEXT

config SAMPLE_STSAFE_HOST_KEY_PLAINTEXT
	bool "Plaintext provisioning"

config SAMPLE_STSAFE_HOST_KEY_WRAPPED
	bool "NIST P-256 wrapped provisioning"
	select STSEPHYR_ECC_NIST_P256
	select STSEPHYR_HOST_SESSION
	select STSEPHYR_HOST_KEY_WRAPPED_PROVISIONING

endchoice

source "Kconfig.zephyr"
```

## sample.yaml
```
sample:
  name: STSAFE-A120 host-key provisioning
  description: Provision host-session keys using an explicitly selected method

common:
  tags: [security, i2c, stsafe, destructive]
  platform_allow: [nucleo_l452re]
  integration_platforms: [nucleo_l452re]
  extra_args: [SHIELD=x_nucleo_ese01a1]
  build_only: true
  extra_configs:
    - CONFIG_SAMPLE_STSAFE_ALLOW_HOST_KEY_PROVISIONING=y

tests:
  sample.stsephyr.host_key_provisioning.plaintext:
    extra_configs:
      - CONFIG_SAMPLE_STSAFE_HOST_KEY_PLAINTEXT=y
  sample.stsephyr.host_key_provisioning.wrapped:
    extra_configs:
      - CONFIG_SAMPLE_STSAFE_HOST_KEY_WRAPPED=y
```

## prj.conf
```kconfig
CONFIG_LOG=y
CONFIG_LOG_MODE_IMMEDIATE=y
CONFIG_LOG_DEFAULT_LEVEL=3
CONFIG_STSEPHYR_LOG_LEVEL_INF=y
CONFIG_SERIAL=y
CONFIG_CONSOLE=y
CONFIG_MAIN_STACK_SIZE=6144
CONFIG_ASSERT=y
```

## src/main.c
```c
/*
 * Copyright (c) 2026 STMicroelectronics
 * SPDX-License-Identifier: Apache-2.0
 */

#include "stsephyr_sample.h"

#include <zephyr/sys/printk.h>

static int load_host_keys(stsafea_aes_128_host_keys_t *keys)
{
	if ((stsephyr_sample_hex_decode(CONFIG_SAMPLE_STSAFE_HOST_MAC_KEY_HEX, keys->host_mac_key,
					STSAFEA_HOST_AES_128_MAC_KEY_SIZE) != 0) ||
	    (stsephyr_sample_hex_decode(CONFIG_SAMPLE_STSAFE_HOST_CIPHER_KEY_HEX,
					keys->host_cipher_key,
					STSAFEA_HOST_AES_128_CIPHER_KEY_SIZE) != 0)) {
		printk("FAIL: both host keys must contain exactly 32 hexadecimal characters\n");
		return -1;
	}

	return 0;
}

int main(void)
{
	stsafea_host_key_provisioning_ctrl_fields_t controls;
	stsafea_aes_128_host_keys_t keys;
	stse_Handler_t *handler;
	stse_ReturnCode_t status;

	stsephyr_sample_banner(
		"STSAFE-A120 host-key provisioning example",
		"Provisions caller-supplied AES-128 host-session keys without changing the "
		"device's provisioning policy.");

#if !defined(CONFIG_SAMPLE_STSAFE_ALLOW_HOST_KEY_PROVISIONING)
	printk("SKIPPED: persistent host-key provisioning is disabled.\n");
	printk("Enabling it replaces the keys used for authenticated and encrypted host "
	       "sessions.\n");
	stsephyr_sample_footer();
	stsephyr_sample_pass("02_host_key_provisioning_safe_skip");
	return 0;
#endif

	if (load_host_keys(&keys) != 0) {
		return 0;
	}
	printk("WARNING: opt-in enabled; the device host keys will be permanently replaced.\n");
	printk("The example will not weaken or lock the current provisioning control fields.\n");
	if (stsephyr_sample_open(&handler) != 0) {
		return 0;
	}

	status = stsafea_query_host_key_provisioning_ctrl_fields(handler, &controls);
	if (stsephyr_sample_status("stsafea_query_host_key_provisioning_ctrl_fields", status) !=
	    0) {
		goto out;
	}
	printk("Host-key controls: change_right=%u reprovision=%u plaintext=%u "
	       "wrapped_anonymous=%u auth_key=0x%02X\n",
	       controls.change_right, controls.reprovision, controls.plaintext,
	       controls.wrapped_anonymous, controls.wrapped_or_DH_derived_authentication_key);

#if defined(CONFIG_SAMPLE_STSAFE_HOST_KEY_WRAPPED)
	printk("Provisioning method: NIST P-256 wrapped transfer\n");
	status = stse_host_key_provisioning_wrapped(handler, STSAFEA_AES_128_HOST_KEY,
						    (stsafea_host_keys_t *)&keys,
						    STSE_ECC_KT_NIST_P_256);
	if (stsephyr_sample_status("stse_host_key_provisioning_wrapped", status) != 0) {
		goto out;
	}
#else
	printk("Provisioning method: plaintext transfer\n");
	status = stse_host_key_provisioning(handler, STSAFEA_AES_128_HOST_KEY,
					    (stsafea_host_keys_t *)&keys);
	if (stsephyr_sample_status("stse_host_key_provisioning", status) != 0) {
		goto out;
	}
#endif

	stsephyr_sample_close();
	stsephyr_sample_footer();
	stsephyr_sample_pass("02_host_key_provisioning");
	return 0;

out:
	stsephyr_sample_close();
	stsephyr_sample_footer();
	return 0;
}
```
