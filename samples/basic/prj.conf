## CMakeLists.txt
```
# Copyright (c) 2026 STMicroelectronics
# SPDX-License-Identifier: Apache-2.0

cmake_minimum_required(VERSION 3.20.0)
find_package(Zephyr REQUIRED HINTS $ENV{ZEPHYR_BASE})
project(stsephyr_basic)

target_sources(app PRIVATE src/main.c)
```

## sample.yaml
```
sample:
  name: STSEphyr basic
  description: Initialize the STSAFE-A120 and check one echo command

common:
  tags: [security, i2c, stsafe]
  platform_allow: [nucleo_l452re]
  integration_platforms: [nucleo_l452re]
  extra_args: [SHIELD=x_nucleo_ese01a1]
  harness: console
  harness_config:
    type: one_line
    regex: ["PASS: basic"]
    fixture: stsafe_a120

tests:
  sample.stsephyr.basic: {}
  sample.stsephyr.basic.all_features:
    extra_conf_files: [full.conf]
```

## prj.conf
```kconfig
CONFIG_LOG=y
CONFIG_MAIN_STACK_SIZE=4096
```

## full.conf
```kconfig
# Copyright (c) 2026 STMicroelectronics
# SPDX-License-Identifier: Apache-2.0

# Enables every optional STSELib feature to build-test the whole integration.
CONFIG_STSEPHYR_ECC_NIST_P521=y
CONFIG_STSEPHYR_ECC_BRAINPOOL_P256=y
CONFIG_STSEPHYR_ECC_BRAINPOOL_P384=y
CONFIG_STSEPHYR_ECC_BRAINPOOL_P512=y
CONFIG_STSEPHYR_ECC_CURVE25519=y
CONFIG_STSEPHYR_ECC_ED25519=y
CONFIG_STSEPHYR_HASH_SHA3_256=y
CONFIG_STSEPHYR_HASH_SHA3_384=y
CONFIG_STSEPHYR_HASH_SHA3_512=y
CONFIG_STSEPHYR_HOST_SESSION=y
CONFIG_STSEPHYR_HOST_KEY_ESTABLISHMENT=y
CONFIG_STSEPHYR_HOST_KEY_WRAPPED_PROVISIONING=y
CONFIG_STSEPHYR_SYMMETRIC_KEY_ESTABLISHMENT=y
CONFIG_STSEPHYR_SYMMETRIC_KEY_WRAPPED_PROVISIONING=y
```

## src/main.c
```c
/*
 * Copyright (c) 2026 STMicroelectronics
 * SPDX-License-Identifier: Apache-2.0
 */

#include <string.h>

#include <zephyr/device.h>
#include <zephyr/devicetree.h>
#include <zephyr/kernel.h>
#include <zephyr/logging/log.h>
#include <zephyr/sys/printk.h>

#include <stsephyr/stsafe_a120.h>

LOG_MODULE_REGISTER(basic, LOG_LEVEL_INF);

static const struct device *const stsafe = DEVICE_DT_GET_ONE(st_stsafe_a120);

int main(void)
{
	static const uint8_t request[] = "STSEphyr/A120";
	uint8_t response[sizeof(request)] = {0};
	stse_Handler_t *handler;
	stse_ReturnCode_t status;
	int ret;

	if (!device_is_ready(stsafe)) {
		LOG_ERR("STSAFE-A120 device is not ready");
		return 0;
	}

	ret = stsephyr_acquire(stsafe, K_MSEC(CONFIG_STSEPHYR_LOCK_TIMEOUT_MS), &handler);
	if (ret != 0) {
		LOG_ERR("could not acquire STSAFE-A120 (%d)", ret);
		return 0;
	}

	status = stse_device_echo(handler, (uint8_t *)request, response, sizeof(request));
	stsephyr_release(stsafe);

	if (status != STSE_OK) {
		LOG_ERR("STSELib echo failed (0x%x)", status);
		return 0;
	}
	if (memcmp(request, response, sizeof(request)) != 0) {
		LOG_ERR("STSAFE-A120 echo response mismatch");
		return 0;
	}

	LOG_INF("STSAFE-A120 echo successful");
	printk("PASS: basic\n");
	return 0;
}
```
