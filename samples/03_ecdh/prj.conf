## CMakeLists.txt
```
# Copyright (c) 2026 STMicroelectronics
# SPDX-License-Identifier: Apache-2.0

cmake_minimum_required(VERSION 3.20.0)
find_package(Zephyr REQUIRED HINTS $ENV{ZEPHYR_BASE})
project(stsephyr_ecdh)

target_sources(app PRIVATE src/main.c)
include(${CMAKE_CURRENT_SOURCE_DIR}/../common/common.cmake)
```

## Kconfig
```
mainmenu "STSAFE-A120 ECDHE example"

config SAMPLE_STSAFE_ENABLE_ECDH
	bool "Enable the host-authenticated ECDHE flow"
	default n
	help
	  The ECDHE keys are ephemeral and do not alter persistent key slots, but
	  the configured host keys must already match the target device.

config SAMPLE_STSAFE_HOST_MAC_KEY_HEX
	string "Provisioned AES-128 host MAC key as 32 hexadecimal characters"
	default ""

config SAMPLE_STSAFE_HOST_CIPHER_KEY_HEX
	string "Provisioned AES-128 host cipher key as 32 hexadecimal characters"
	default ""

source "Kconfig.zephyr"
```

## sample.yaml
```
sample:
  name: STSAFE-A120 ephemeral ECDH
  description: Compare host and secure-element NIST P-256 ECDHE shared secrets

common:
  tags: [security, i2c, stsafe, provisioned]
  platform_allow: [nucleo_l452re]
  integration_platforms: [nucleo_l452re]
  extra_args: [SHIELD=x_nucleo_ese01a1]
  build_only: true
  extra_configs:
    - CONFIG_SAMPLE_STSAFE_ENABLE_ECDH=y

tests:
  sample.stsephyr.ecdh: {}
```

## prj.conf
```kconfig
CONFIG_LOG=y
CONFIG_LOG_MODE_IMMEDIATE=y
CONFIG_LOG_DEFAULT_LEVEL=3
CONFIG_STSEPHYR_LOG_LEVEL_INF=y
CONFIG_STSEPHYR_ECC_NIST_P256=y
CONFIG_STSEPHYR_HOST_SESSION=y
CONFIG_STSEPHYR_HOST_KEY_ESTABLISHMENT=y
CONFIG_SERIAL=y
CONFIG_CONSOLE=y
CONFIG_MAIN_STACK_SIZE=6144
CONFIG_ASSERT=y
```

## src/main.c
```c
/*
 * Copyright (c) 2026 STMicroelectronics
 * SPDX-License-Identifier: Apache-2.0
 */

#include "stsephyr_sample.h"

#include <string.h>
#include <zephyr/sys/printk.h>

#include <core/stse_platform.h>

#define ECDH_KEY_TYPE		STSE_ECC_KT_NIST_P_256
#define ECDH_EPHEMERAL_SLOT	0xFFU
#define ECDH_PUBLIC_KEY_SIZE	64U
#define ECDH_PRIVATE_KEY_SIZE	32U
#define ECDH_SHARED_SECRET_SIZE 32U

static int load_host_keys(stsafea_aes_128_host_keys_t *keys)
{
	if ((stsephyr_sample_hex_decode(CONFIG_SAMPLE_STSAFE_HOST_MAC_KEY_HEX, keys->host_mac_key,
					STSAFEA_HOST_AES_128_MAC_KEY_SIZE) != 0) ||
	    (stsephyr_sample_hex_decode(CONFIG_SAMPLE_STSAFE_HOST_CIPHER_KEY_HEX,
					keys->host_cipher_key,
					STSAFEA_HOST_AES_128_CIPHER_KEY_SIZE) != 0)) {
		printk("FAIL: both provisioned host keys must be supplied as 32 hex characters\n");
		return -1;
	}

	return 0;
}

int main(void)
{
	uint8_t host_private_key[ECDH_PRIVATE_KEY_SIZE];
	uint8_t host_public_key[ECDH_PUBLIC_KEY_SIZE];
	uint8_t device_public_key[ECDH_PUBLIC_KEY_SIZE];
	uint8_t host_secret[ECDH_SHARED_SECRET_SIZE];
	uint8_t device_secret[ECDH_SHARED_SECRET_SIZE];
	stsafea_aes_128_host_keys_t host_keys;
	stse_session_t session;
	stse_Handler_t *handler;
	stse_ReturnCode_t status;

	stsephyr_sample_banner(
		"STSAFE-A120 ephemeral ECDH example",
		"Generates ephemeral NIST P-256 key pairs on the host and secure element and "
		"compares their shared secrets.");

#if !defined(CONFIG_SAMPLE_STSAFE_ENABLE_ECDH)
	printk("SKIPPED: ECDH is disabled until matching provisioned host keys are supplied.\n");
	stsephyr_sample_footer();
	stsephyr_sample_pass("03_ecdh_safe_skip");
	return 0;
#endif

	if (load_host_keys(&host_keys) != 0) {
		return 0;
	}
	if (stsephyr_sample_open(&handler) != 0) {
		return 0;
	}

	status = stse_platform_ecc_generate_key_pair(ECDH_KEY_TYPE, host_private_key,
						     host_public_key);
	if (stsephyr_sample_status("stse_platform_ecc_generate_key_pair", status) != 0) {
		goto out;
	}
	status = stsafea_generate_ecc_key_pair(handler, ECDH_EPHEMERAL_SLOT, ECDH_KEY_TYPE, 1U,
					       device_public_key);
	if (stsephyr_sample_status("stsafea_generate_ecc_key_pair(ephemeral)", status) != 0) {
		goto out;
	}

	stsafea_session_clear_context(&session);
	status = stsafea_open_host_session(handler, &session, host_keys.host_mac_key,
					   host_keys.host_cipher_key);
	if (stsephyr_sample_status("stsafea_open_host_session", status) != 0) {
		goto out;
	}

	status = stse_ecc_establish_shared_secret(handler, ECDH_EPHEMERAL_SLOT, ECDH_KEY_TYPE,
						  host_public_key, device_secret);
	if (stsephyr_sample_status("stse_ecc_establish_shared_secret", status) != 0) {
		stsafea_close_host_session(&session);
		goto out;
	}
	stsafea_close_host_session(&session);

	status = stse_platform_ecc_ecdh(ECDH_KEY_TYPE, device_public_key, host_private_key,
					host_secret);
	if (stsephyr_sample_status("stse_platform_ecc_ecdh", status) != 0) {
		goto out;
	}
	if (memcmp(host_secret, device_secret, sizeof(host_secret)) != 0) {
		printk("FAIL: host and STSAFE-A120 shared secrets differ\n");
		goto out;
	}
	printk(" - Host and STSAFE-A120 shared secrets match\n");

	stsephyr_sample_close();
	stsephyr_sample_footer();
	stsephyr_sample_pass("03_ecdh");
	return 0;

out:
	stsephyr_sample_close();
	stsephyr_sample_footer();
	return 0;
}
```
