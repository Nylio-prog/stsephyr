## CMakeLists.txt
```
# Copyright (c) 2026 STMicroelectronics
# SPDX-License-Identifier: Apache-2.0

cmake_minimum_required(VERSION 3.20.0)
find_package(Zephyr REQUIRED HINTS $ENV{ZEPHYR_BASE})
project(stsephyr_random_number)

target_sources(app PRIVATE src/main.c)
include(${CMAKE_CURRENT_SOURCE_DIR}/../common/common.cmake)
```

## sample.yaml
```
sample:
  name: STSAFE-A120 random number
  description: Read random bytes from the STSAFE-A120

common:
  tags: [security, i2c, stsafe]
  platform_allow: [nucleo_l452re]
  integration_platforms: [nucleo_l452re]
  extra_args: [SHIELD=x_nucleo_ese01a1]
  harness: console
  harness_config:
    type: one_line
    regex: ["PASS: 01_random_number"]
    fixture: stsafe_a120

tests:
  sample.stsephyr.random_number: {}
```

## prj.conf
```kconfig
CONFIG_LOG=y
CONFIG_LOG_DEFAULT_LEVEL=3
CONFIG_STSEPHYR_LOG_LEVEL_INF=y
CONFIG_SERIAL=y
CONFIG_CONSOLE=y
CONFIG_MAIN_STACK_SIZE=4096
CONFIG_ASSERT=y
```

## src/main.c
```c
/*
 * Copyright (c) 2026 STMicroelectronics
 * SPDX-License-Identifier: Apache-2.0
 *
 * Reads random bytes from the STSAFE-A120 random number generator.
 */

#include "sample_common.h"

#include <zephyr/sys/printk.h>

int main(void)
{
	uint8_t random[64];
	stse_Handler_t *handler;

	printk("STSAFE-A120 random number generation\n");
	if (sample_open(&handler) != 0) {
		return 0;
	}

	if (sample_check("Generate 64 random bytes",
			 stse_generate_random(handler, random, sizeof(random))) == 0) {
		sample_print_hex("Random data", random, sizeof(random));
		printk("PASS: 01_random_number\n");
	}

	sample_close();
	return 0;
}
```
