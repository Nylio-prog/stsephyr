## Kconfig
```kconfig
# Copyright (c) 2026 STMicroelectronics
# SPDX-License-Identifier: Apache-2.0

rsource "drivers/stsafe/Kconfig"
```

## boards/shields/x_nucleo_ese01a1/Kconfig.defconfig
```kconfig
# Copyright (c) 2026 STMicroelectronics
# SPDX-License-Identifier: Apache-2.0

if SHIELD_X_NUCLEO_ESE01A1

config STSEPHYR
	default y

endif
```

## boards/shields/x_nucleo_ese01a1/Kconfig.shield
```kconfig
# Copyright (c) 2026 STMicroelectronics
# SPDX-License-Identifier: Apache-2.0

config SHIELD_X_NUCLEO_ESE01A1
	def_bool $(shields_list_contains,x_nucleo_ese01a1)
```

## drivers/stsafe/Kconfig
```kconfig
# Copyright (c) 2026 STMicroelectronics
# SPDX-License-Identifier: Apache-2.0

menuconfig STSEPHYR
	bool "STSELib port for STSAFE-A120"
	default y if DT_HAS_ST_STSAFE_A120_ENABLED
	depends on DT_HAS_ST_STSAFE_A120_ENABLED
	select I2C
	select GPIO
	select CSPRNG_NEEDED
	select PSA_CRYPTO
	select PSA_WANT_KEY_TYPE_ECC_PUBLIC_KEY
	select PSA_WANT_KEY_TYPE_ECC_KEY_PAIR_IMPORT
	select PSA_WANT_KEY_TYPE_ECC_KEY_PAIR_EXPORT
	select PSA_WANT_KEY_TYPE_ECC_KEY_PAIR_GENERATE
	select PSA_WANT_KEY_TYPE_ECC_KEY_PAIR_DERIVE
	select PSA_WANT_KEY_TYPE_AES
	select PSA_WANT_KEY_TYPE_HMAC
	select PSA_WANT_ALG_ECDSA
	select PSA_WANT_ALG_ECDH
	select PSA_WANT_ALG_CMAC
	select PSA_WANT_ALG_CBC_NO_PADDING
	select PSA_WANT_ALG_ECB_NO_PADDING
	select PSA_WANT_ALG_HMAC
	select PSA_WANT_ALG_SHA_256
	select PSA_WANT_ALG_SHA_384
	select PSA_WANT_ALG_SHA_512
	help
	  Zephyr driver for STSAFE-A120 secure elements connected over I2C,
	  built on ST's STSELib middleware. Enabled automatically when the
	  devicetree contains an enabled "st,stsafe-a120" node.

if STSEPHYR

config STSEPHYR_INIT_PRIORITY
	int "Device initialization priority"
	default 80
	range 0 99
	help
	  POST_KERNEL initialization priority. The I2C and GPIO controllers must
	  already be ready.

config STSEPHYR_MAX_INSTANCES
	int "Maximum STSAFE-A120 instances"
	default 1
	range 1 8
	help
	  Number of STSAFE-A120 devicetree nodes supported. All devices share
	  one lock because STSELib has global state.

config STSEPHYR_LOCK_TIMEOUT_MS
	int "Default device lock timeout in milliseconds"
	default 5000
	range 1 60000
	help
	  Convenience value for applications calling stsephyr_acquire(); the
	  samples use it. The driver itself does not.

config STSEPHYR_RESET_ASSERT_MS
	int "Reset pulse length in milliseconds"
	default 1
	range 1 1000

config STSEPHYR_USE_RSP_POLLING
	bool "Poll for command responses"
	default y
	help
	  Read the response as soon as the device is ready instead of waiting
	  for the worst-case command execution time.

if STSEPHYR_USE_RSP_POLLING

config STSEPHYR_MAX_POLLING_RETRY
	int "Maximum response polling attempts"
	default 100
	range 1 1000

config STSEPHYR_FIRST_POLLING_INTERVAL_MS
	int "Delay before the first response attempt"
	default 10
	range 1 1000

config STSEPHYR_POLLING_RETRY_INTERVAL_MS
	int "Delay between response polling attempts"
	default 10
	range 1 1000

endif

menu "STSELib algorithms"

config STSEPHYR_ECC_NIST_P256
	bool "NIST P-256"
	default y
	select PSA_WANT_ECC_SECP_R1_256

config STSEPHYR_ECC_NIST_P384
	bool "NIST P-384"
	default y
	select PSA_WANT_ECC_SECP_R1_384

config STSEPHYR_ECC_NIST_P521
	bool "NIST P-521"
	default n
	select PSA_WANT_ECC_SECP_R1_521

config STSEPHYR_ECC_BRAINPOOL_P256
	bool "Brainpool P-256"
	default n
	select PSA_WANT_ECC_BRAINPOOL_P_R1_256

config STSEPHYR_ECC_BRAINPOOL_P384
	bool "Brainpool P-384"
	default n
	select PSA_WANT_ECC_BRAINPOOL_P_R1_384

config STSEPHYR_ECC_BRAINPOOL_P512
	bool "Brainpool P-512"
	default n
	select PSA_WANT_ECC_BRAINPOOL_P_R1_512

config STSEPHYR_ECC_CURVE25519
	bool "Curve25519"
	default n
	select PSA_WANT_ECC_MONTGOMERY_255

config STSEPHYR_ECC_ED25519
	bool "Ed25519/EdDSA"
	default n
	help
	  Enable STSELib support for Ed25519 keys and pure EdDSA commands on
	  STSAFE-A120. This also builds the west-managed Monocypher Ed25519
	  implementation so the MCU can verify EdDSA signatures and Ed25519
	  certificate chains. Monocypher is not linked when this option is
	  disabled.

config STSEPHYR_HASH_SHA256
	bool "SHA-256"
	default y
	select PSA_WANT_ALG_SHA_256

config STSEPHYR_HASH_SHA384
	bool "SHA-384"
	default y
	select PSA_WANT_ALG_SHA_384

config STSEPHYR_HASH_SHA512
	bool "SHA-512"
	default y
	select PSA_WANT_ALG_SHA_512

config STSEPHYR_HASH_SHA3_256
	bool "SHA3-256"
	default n
	select PSA_WANT_ALG_SHA3_256

config STSEPHYR_HASH_SHA3_384
	bool "SHA3-384"
	default n
	select PSA_WANT_ALG_SHA3_384

config STSEPHYR_HASH_SHA3_512
	bool "SHA3-512"
	default n
	select PSA_WANT_ALG_SHA3_512

endmenu

config STSEPHYR_HOST_SESSION
	bool "STSAFE host secure sessions"
	default n
	help
	  STSELib host sessions: commands authenticated (C-MAC) and optionally
	  encrypted with the host keys. The keys must already be provisioned in
	  the device; this option does not provision anything.

config STSEPHYR_HOST_KEY_ESTABLISHMENT
	bool "Host key establishment helpers"
	help
	  STSELib functions that establish host keys with ECDH.

config STSEPHYR_HOST_KEY_WRAPPED_PROVISIONING
	bool "Wrapped host-key provisioning helpers"
	help
	  STSELib functions that provision host keys wrapped with a KEK.

config STSEPHYR_SYMMETRIC_KEY_ESTABLISHMENT
	bool "Symmetric-key establishment helpers"
	help
	  STSELib functions that establish symmetric keys with ECDH.

config STSEPHYR_SYMMETRIC_KEY_WRAPPED_PROVISIONING
	bool "Wrapped symmetric-key provisioning helpers"
	help
	  STSELib functions that provision symmetric keys wrapped with a KEK.

module = STSEPHYR
module-str = stsephyr
module-help = STSAFE-A120 driver logging
source "subsys/logging/Kconfig.template.log_config"

endif
```

## dts/bindings/crypto/st,stsafe-a120.yaml
```yaml
# Copyright (c) 2026 STMicroelectronics
# SPDX-License-Identifier: Apache-2.0

description: |
  STMicroelectronics STSAFE-A120 authentication secure element connected over
  I2C. The I2C address is part of the device personalization and is therefore
  supplied by the reg property.

compatible: "st,stsafe-a120"

include: i2c-device.yaml

on-bus: i2c

properties:
  reset-gpios:
    type: phandle-array
    required: true
    description: GPIO connected to the active-low STSAFE-A120 reset input.
```

## samples/01_echo_loop/sample.yaml
```yaml
sample:
  name: STSAFE-A120 echo loop
  description: Exercise variable-length STSAFE-A120 echo commands

common:
  tags: [security, i2c, stsafe]
  platform_allow: [nucleo_l452re]
  integration_platforms: [nucleo_l452re]
  extra_args: [SHIELD=x_nucleo_ese01a1]
  harness: console
  harness_config:
    type: one_line
    regex: ["PASS: 01_echo_loop"]
    fixture: stsafe_a120

tests:
  sample.stsephyr.echo_loop: {}
```

## samples/01_hash/Kconfig
```kconfig
# Copyright (c) 2026 STMicroelectronics
# SPDX-License-Identifier: Apache-2.0

mainmenu "STSAFE-A120 hash sample"

choice SAMPLE_HASH_ALGORITHM
	prompt "Hash algorithm"
	default SAMPLE_HASH_SHA256

config SAMPLE_HASH_SHA256
	bool "SHA-256"
	select STSEPHYR_HASH_SHA256

config SAMPLE_HASH_SHA3_256
	bool "SHA3-256"
	select STSEPHYR_HASH_SHA3_256

config SAMPLE_HASH_SHA3_384
	bool "SHA3-384"
	select STSEPHYR_HASH_SHA3_384

config SAMPLE_HASH_SHA3_512
	bool "SHA3-512"
	select STSEPHYR_HASH_SHA3_512

endchoice

source "Kconfig.zephyr"
```

## samples/01_hash/sample.yaml
```yaml
sample:
  name: STSAFE-A120 hash
  description: Compare STSAFE-A120 and MCU digests (SHA-256 and SHA3 variants)

common:
  tags: [security, i2c, stsafe]
  platform_allow: [nucleo_l452re]
  integration_platforms: [nucleo_l452re]
  extra_args: [SHIELD=x_nucleo_ese01a1]
  harness: console
  harness_config:
    type: one_line
    regex: ["PASS: 01_hash"]
    fixture: stsafe_a120

tests:
  sample.stsephyr.hash: {}
  sample.stsephyr.hash.sha3_256:
    extra_configs:
      - CONFIG_SAMPLE_HASH_SHA3_256=y
  sample.stsephyr.hash.sha3_384:
    extra_configs:
      - CONFIG_SAMPLE_HASH_SHA3_384=y
  sample.stsephyr.hash.sha3_512:
    extra_configs:
      - CONFIG_SAMPLE_HASH_SHA3_512=y
```

## samples/01_key_pair_generation/Kconfig
```kconfig
mainmenu "STSAFE-A120 key-pair generation example"

config SAMPLE_STSAFE_ALLOW_KEY_PAIR_GENERATION
	bool "Allow persistent asymmetric key-pair generation"
	default n
	help
	  DANGEROUS: generating a key pair replaces the selected private-key slot
	  and configures its usage limit. Keep this disabled unless the target slot
	  is explicitly available for destructive testing.

config SAMPLE_STSAFE_KEY_SLOT
	int "Asymmetric private-key slot"
	default 1
	range 1 4

config SAMPLE_STSAFE_KEY_USAGE_LIMIT
	int "Generated private-key usage limit"
	default 255
	range 1 255
	help
	  Each signature consumes one use when the slot is configured with a
	  finite usage limit.

choice SAMPLE_STSAFE_KEY_CURVE
	prompt "Generated key curve"
	default SAMPLE_STSAFE_KEY_CURVE_NIST_P256

config SAMPLE_STSAFE_KEY_CURVE_NIST_P256
	bool "NIST P-256"
	select STSEPHYR_ECC_NIST_P256

config SAMPLE_STSAFE_KEY_CURVE_NIST_P521
	bool "NIST P-521"
	select STSEPHYR_ECC_NIST_P521

config SAMPLE_STSAFE_KEY_CURVE_BRAINPOOL_P512
	bool "Brainpool P-512"
	select STSEPHYR_ECC_BRAINPOOL_P512

endchoice

source "Kconfig.zephyr"
```

## samples/01_key_pair_generation/sample.yaml
```yaml
sample:
  name: STSAFE-A120 asymmetric key-pair generation
  description: Generate and exercise a persistent ECC private-key slot

common:
  tags: [security, i2c, stsafe, destructive]
  platform_allow: [nucleo_l452re]
  integration_platforms: [nucleo_l452re]
  extra_args: [SHIELD=x_nucleo_ese01a1]
  build_only: true
  extra_configs:
    - CONFIG_SAMPLE_STSAFE_ALLOW_KEY_PAIR_GENERATION=y

tests:
  sample.stsephyr.key_pair_generation.nist_p256:
    extra_configs:
      - CONFIG_SAMPLE_STSAFE_KEY_CURVE_NIST_P256=y
  sample.stsephyr.key_pair_generation.nist_p521:
    extra_configs:
      - CONFIG_SAMPLE_STSAFE_KEY_CURVE_NIST_P521=y
  sample.stsephyr.key_pair_generation.brainpool_p512:
    extra_configs:
      - CONFIG_SAMPLE_STSAFE_KEY_CURVE_BRAINPOOL_P512=y
```

## samples/01_secure_data_storage_counter_access/Kconfig
```kconfig
mainmenu "STSAFE-A120 counter-zone example"

config SAMPLE_STSAFE_COUNTER_ZONE
	int "Counter-zone index"
	default 5
	range 0 255
	help
	  Zone 5 matches the STSAFE-A120 SPL05 default personalization.

config SAMPLE_STSAFE_ALLOW_COUNTER_DECREMENT
	bool "Allow the example to decrement the one-way counter"
	default n
	help
	  DANGEROUS: each run permanently consumes counter state. Keep this off for
	  normal builds and hardware validation.

source "Kconfig.zephyr"
```

## samples/01_secure_data_storage_counter_access/sample.yaml
```yaml
sample:
  name: STSAFE-A120 counter-zone access
  description: Discover and read an STSAFE-A120 counter zone without decrementing it

common:
  tags: [security, i2c, stsafe]
  platform_allow: [nucleo_l452re]
  integration_platforms: [nucleo_l452re]
  build_only: true
  extra_args: [SHIELD=x_nucleo_ese01a1]

tests:
  sample.stsephyr.counter_access: {}
```

## samples/01_secure_data_storage_zone_access/Kconfig
```kconfig
mainmenu "STSAFE-A120 data-zone example"

config SAMPLE_STSAFE_DATA_ZONE
	int "Data-zone index"
	default 1
	range 0 255
	help
	  Zone 1 matches the STSAFE-A120 SPL05 default personalization.

config SAMPLE_STSAFE_ALLOW_ZONE_UPDATE
	bool "Allow the example to update secure-element NVM"
	default n
	help
	  DANGEROUS: this changes persistent data and consumes NVM write endurance.
	  Keep this off for normal builds and hardware validation.

source "Kconfig.zephyr"
```

## samples/01_secure_data_storage_zone_access/sample.yaml
```yaml
sample:
  name: STSAFE-A120 data-zone access
  description: Discover and read an STSAFE-A120 data zone without updating it

common:
  tags: [security, i2c, stsafe]
  platform_allow: [nucleo_l452re]
  integration_platforms: [nucleo_l452re]
  build_only: true
  extra_args: [SHIELD=x_nucleo_ese01a1]

tests:
  sample.stsephyr.zone_access: {}
```

## samples/04_symmetric_key_control_fields/Kconfig
```kconfig
mainmenu "STSAFE-A120 symmetric-key provisioning-control example"

config SAMPLE_STSAFE_SYMMETRIC_KEY_SLOT
	int "Symmetric-key slot"
	default 0
	range 0 255

config SAMPLE_STSAFE_ALLOW_SYMMETRIC_CONTROL_UPDATE
	bool "Allow persistent symmetric-key control-field update"
	default n
	help
	  DANGEROUS: changes which provisioning mechanisms are accepted by the
	  selected symmetric-key slot. The example preserves all existing fields,
	  enables anonymous wrapped and ECDHE provisioning, and refuses to write if
	  the slot's change_right is already disabled.

source "Kconfig.zephyr"
```

## samples/04_symmetric_key_control_fields/sample.yaml
```yaml
sample:
  name: STSAFE-A120 symmetric-key provisioning controls
  description: Audit or explicitly extend a symmetric-key slot provisioning policy

common:
  tags: [security, i2c, stsafe]
  platform_allow: [nucleo_l452re]
  integration_platforms: [nucleo_l452re]
  extra_args: [SHIELD=x_nucleo_ese01a1]
  harness: console
  harness_config:
    type: one_line
    regex: ["PASS: 04_symmetric_key_control_fields"]
    fixture: stsafe_a120

tests:
  sample.stsephyr.symmetric_key_control_fields.audit: {}
  sample.stsephyr.symmetric_key_control_fields.update:
    build_only: true
    tags: [destructive]
    extra_configs:
      - CONFIG_SAMPLE_STSAFE_ALLOW_SYMMETRIC_CONTROL_UPDATE=y
```

## samples/05_symmetric_key_operations/Kconfig
```kconfig
mainmenu "STSAFE-A120 symmetric-key operation example"

config SAMPLE_STSAFE_ALLOW_SYMMETRIC_KEY_WRITE
	bool "Allow persistent symmetric-key slot replacement"
	default n
	help
	  DANGEROUS: every mode writes or establishes a new key in the selected
	  symmetric-key slot before exercising it. Existing key material and slot
	  metadata are replaced.

config SAMPLE_STSAFE_SYMMETRIC_KEY_SLOT
	int "Symmetric-key slot"
	default 0
	range 0 255

config SAMPLE_STSAFE_HOST_MAC_KEY_HEX
	string "Provisioned AES-128 host MAC key as 32 hexadecimal characters"
	default ""

config SAMPLE_STSAFE_HOST_CIPHER_KEY_HEX
	string "Provisioned AES-128 host cipher key as 32 hexadecimal characters"
	default ""

choice SAMPLE_STSAFE_SYMMETRIC_OPERATION
	prompt "Provisioning and operation mode"
	default SAMPLE_STSAFE_SYMMETRIC_ESTABLISH_CMAC

config SAMPLE_STSAFE_SYMMETRIC_ESTABLISH_CMAC
	bool "ECDHE establish AES-128 CMAC key"
	select STSEPHYR_ECC_NIST_P256
	select STSEPHYR_HOST_SESSION
	select STSEPHYR_SYMMETRIC_KEY_ESTABLISHMENT

config SAMPLE_STSAFE_SYMMETRIC_ESTABLISH_CCM
	bool "ECDHE establish AES-256 CCM key"
	select STSEPHYR_ECC_NIST_P256
	select STSEPHYR_HOST_SESSION
	select STSEPHYR_SYMMETRIC_KEY_ESTABLISHMENT

config SAMPLE_STSAFE_SYMMETRIC_WRAPPED_CMAC
	bool "Wrapped provision AES-128 CMAC key"
	select STSEPHYR_ECC_NIST_P256
	select STSEPHYR_HOST_SESSION
	select STSEPHYR_SYMMETRIC_KEY_WRAPPED_PROVISIONING

config SAMPLE_STSAFE_SYMMETRIC_WRAPPED_CCM
	bool "Wrapped provision AES-256 CCM key"
	select STSEPHYR_ECC_NIST_P256
	select STSEPHYR_HOST_SESSION
	select STSEPHYR_SYMMETRIC_KEY_WRAPPED_PROVISIONING

endchoice

source "Kconfig.zephyr"
```

## samples/05_symmetric_key_operations/sample.yaml
```yaml
sample:
  name: STSAFE-A120 symmetric-key provisioning and operations
  description: Provision or establish a key and exercise CMAC or CCM

common:
  tags: [security, i2c, stsafe, destructive, provisioned]
  platform_allow: [nucleo_l452re]
  integration_platforms: [nucleo_l452re]
  extra_args: [SHIELD=x_nucleo_ese01a1]
  build_only: true
  extra_configs:
    - CONFIG_SAMPLE_STSAFE_ALLOW_SYMMETRIC_KEY_WRITE=y

tests:
  sample.stsephyr.symmetric_key.establish_cmac:
    extra_configs:
      - CONFIG_SAMPLE_STSAFE_SYMMETRIC_ESTABLISH_CMAC=y
  sample.stsephyr.symmetric_key.establish_ccm:
    extra_configs:
      - CONFIG_SAMPLE_STSAFE_SYMMETRIC_ESTABLISH_CCM=y
  sample.stsephyr.symmetric_key.wrapped_cmac:
    extra_configs:
      - CONFIG_SAMPLE_STSAFE_SYMMETRIC_WRAPPED_CMAC=y
  sample.stsephyr.symmetric_key.wrapped_ccm:
    extra_configs:
      - CONFIG_SAMPLE_STSAFE_SYMMETRIC_WRAPPED_CCM=y
```
