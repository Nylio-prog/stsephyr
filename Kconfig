## samples/project_template/sample.yaml
```yaml
sample:
  name: STSEphyr customer project template
  description: Minimal safe starting point for an STSAFE-A120 Zephyr application

common:
  tags: [security, i2c, stsafe]
  platform_allow: [nucleo_l452re]
  integration_platforms: [nucleo_l452re]
  extra_args: [SHIELD=x_nucleo_ese01a1]
  harness: console
  harness_config:
    type: one_line
    regex: ["PASS: project_template"]
    fixture: stsafe_a120

tests:
  sample.stsephyr.project_template: {}
```

## tests/platform_crc/testcase.yaml
```yaml
tests:
  stsephyr.platform.crc:
    tags: [stsafe, crc]
    platform_allow: [native_sim, nucleo_l452re]
    integration_platforms: [native_sim]
```

## tests/platform_crypto/testcase.yaml
```yaml
tests:
  stsephyr.platform.crypto:
    tags: [stsafe, crypto]
    platform_allow: [native_sim, nucleo_l452re]
    integration_platforms: [native_sim]
```

## west.yml
```yaml
manifest:
  version: "1.2"

  remotes:
    - name: zephyrproject-rtos
      url-base: https://github.com/zephyrproject-rtos
    - name: stmicroelectronics
      url-base: https://github.com/STMicroelectronics
    - name: monocypher
      url-base: https://github.com/LoupVaillant

  projects:
    - name: zephyr
      remote: zephyrproject-rtos
      revision: v4.4.0
      import:
        name-allowlist:
          - cmsis
          - cmsis_6
          - hal_stm32
          - mbedtls
          - tf-psa-crypto

    - name: stselib
      remote: stmicroelectronics
      repo-path: STSELib
      revision: v1.1.9
      path: modules/lib/stselib
      groups:
        - stse

    - name: monocypher
      remote: monocypher
      repo-path: Monocypher
      revision: 4.0.3
      path: modules/crypto/monocypher
      groups:
        - crypto

  self:
    path: stsephyr
```
